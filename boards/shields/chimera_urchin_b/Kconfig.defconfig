## boards/shields/chimera_urchin_b/Kconfig.defconfig
```kconfig
if SHIELD_CHIMERA_URCHIN_B_LEFT

config ZMK_KEYBOARD_NAME
    default "chmra_urchn_b"

config ZMK_SPLIT_ROLE_CENTRAL
    default y

endif

if SHIELD_CHIMERA_URCHIN_B_LEFT || SHIELD_CHIMERA_URCHIN_B_RIGHT

config ZMK_SPLIT
    default y
endif
```

## boards/shields/chimera_urchin_b/Kconfig.shield
```kconfig
config SHIELD_CHIMERA_URCHIN_B_LEFT
    def_bool $(shields_list_contains,chimera_urchin_b_left)

config SHIELD_CHIMERA_URCHIN_B_RIGHT
    def_bool $(shields_list_contains,chimera_urchin_b_right)
```

## boards/shields/sandbender_b_v0/Kconfig.defconfig
```kconfig
if SHIELD_SANDBENDER_B_V0_LEFT

config ZMK_KEYBOARD_NAME
    default "sndbndr_b_v0"

config ZMK_SPLIT_ROLE_CENTRAL
    default y

endif

if SHIELD_SANDBENDER_B_V0_LEFT || SHIELD_SANDBENDER_B_V0_RIGHT

config ZMK_SPLIT
    default y
endif
```

## boards/shields/sandbender_b_v0/Kconfig.shield
```kconfig
config SHIELD_SANDBENDER_B_V0_LEFT
    def_bool $(shields_list_contains,sandbender_b_v0_left)

config SHIELD_SANDBENDER_B_V0_RIGHT
    def_bool $(shields_list_contains,sandbender_b_v0_right)
```

## boards/shields/sandbender_e_v0/Kconfig.defconfig
```kconfig
// Left Config
if SHIELD_SANDBENDER_E_V0_LEFT

config ZMK_KEYBOARD_NAME
    default "sandbender"

config ZMK_SPLIT_ROLE_CENTRAL
    default y

endif

// Shared Config
if SHIELD_SANDBENDER_E_V0_LEFT || SHIELD_SANDBENDER_E_V0_RIGHT

config ZMK_SPLIT
    default y
endif
```

## boards/shields/sandbender_e_v0/Kconfig.shield
```kconfig
config SHIELD_SANDBENDER_E_V0_LEFT
    def_bool $(shields_list_contains,sandbender_e_v0_left)

config SHIELD_SANDBENDER_E_V0_RIGHT
    def_bool $(shields_list_contains,sandbender_e_v0_right)
```

## boards/shields/urchin/Kconfig.shield
```kconfig
# Copyright (c) 2022 Duccio Breschi
# SPDX-License-Identifier: MIT

config SHIELD_URCHIN_LEFT
    def_bool $(shields_list_contains,urchin_left)

config SHIELD_URCHIN_RIGHT
    def_bool $(shields_list_contains,urchin_right)

config SHIELD_URCHIN_DONGLE
    def_bool $(shields_list_contains,urchin_dongle)
```
