## boards/shields/urchin/Kconfig.defconfig
```kconfig
# Copyright (c) 2022 Duccio Breschi
# SPDX-License-Identifier: MIT

if SHIELD_URCHIN_LEFT || SHIELD_URCHIN_DONGLE

config ZMK_KEYBOARD_NAME
    default "urchin"

config ZMK_SPLIT_ROLE_CENTRAL
    default y

endif

if SHIELD_URCHIN_LEFT || SHIELD_URCHIN_RIGHT || SHIELD_URCHIN_DONGLE
config ZMK_SPLIT
    default y
endif
```
